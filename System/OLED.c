#include "OLED.h"
#include "I2C.h"
#include "Delay.h"
#define OLED_ADDR  0x78    // SSD1306 I2C地址



// ===== 写命令 =====
void OLED_WriteCmd(uint8_t cmd)
{
    I2C_Start();
    I2C_SendByte(OLED_ADDR);     // 设备地址
    I2C_WaitAck();
    I2C_SendByte(0x00);          // 0x00 = 命令模式
    I2C_WaitAck();
    I2C_SendByte(cmd);           // 命令数据
    I2C_WaitAck();
    I2C_Stop();
}

// ===== 写数据 =====
void OLED_WriteData(uint8_t data)
{
    I2C_Start();
    I2C_SendByte(OLED_ADDR);     // 设备地址
    I2C_WaitAck();
    I2C_SendByte(0x40);          // 0x40 = 数据模式
    I2C_WaitAck();
    I2C_SendByte(data);          // 显示数据
    I2C_WaitAck();
    I2C_Stop();
}

// ===== 清屏（全写0） =====
void OLED_Clear(void)
{
    uint8_t page, col;
    for (page = 0; page < 8; page++)
    {
        OLED_WriteCmd(0xB0 + page);   // 设置页地址
        OLED_WriteCmd(0x00);          // 设置列地址低4位
        OLED_WriteCmd(0x10);          // 设置列地址高4位
        for (col = 0; col < 128; col++)
        {
            OLED_WriteData(0x00);     // 写0 = 灭
        }
    }
}

// ===== 初始化 =====
void OLED_Init(void)
{
    I2C_GPIO_Init();
    Delay_ms(100);               // 上电等100ms让OLED稳定
    
    OLED_WriteCmd(0xAE);        // 关显示
    OLED_WriteCmd(0xD5);        // 设置时钟分频比/振荡器频率
    OLED_WriteCmd(0x80);        // 默认值
    OLED_WriteCmd(0xA8);        // 设置多路复用率
    OLED_WriteCmd(0x3F);        // 1/64 duty（128x64屏幕）
    OLED_WriteCmd(0xD3);        // 设置显示偏移
    OLED_WriteCmd(0x00);        // 无偏移
    OLED_WriteCmd(0x40);        // 设置显示起始行 = 0
    OLED_WriteCmd(0x8D);        // 电荷泵设置
    OLED_WriteCmd(0x14);        // 开启电荷泵（关键！不开屏幕不亮）
    OLED_WriteCmd(0x20);        // 设置内存寻址模式
    OLED_WriteCmd(0x00);        // 水平寻址模式
    OLED_WriteCmd(0xA1);        // 段重映射（列地址127映射到SEG0）
    OLED_WriteCmd(0xC8);        // COM扫描方向（从COM63到COM0）
    OLED_WriteCmd(0xDA);        // 设置COM引脚硬件配置
    OLED_WriteCmd(0x12);
    OLED_WriteCmd(0x81);        // 设置对比度
    OLED_WriteCmd(0xCF);        // 对比度值
    OLED_WriteCmd(0xD9);        // 设置预充电周期
    OLED_WriteCmd(0xF1);
    OLED_WriteCmd(0xDB);        // 设置VCOMH取消选择级别
    OLED_WriteCmd(0x40);
    OLED_WriteCmd(0xA4);        // 全局显示开启（输出跟随RAM内容）
    OLED_WriteCmd(0xA6);        // 正常显示（非反色）
    OLED_WriteCmd(0xAF);        // 开显示！
    
    OLED_Clear();               // 清屏
}

// ===== 5x7 ASCII字模表（从空格0x20到~0x7E）=====
static const uint8_t ASCII[][5] = {
    {0x00,0x00,0x00,0x00,0x00}, // space
    {0x00,0x00,0x2F,0x00,0x00}, // !
    {0x00,0x07,0x00,0x07,0x00}, // "
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    {0x44,0x64,0x54,0x4C,0x44}  // z
};

// ===== 显示一个字符（页寻址模式）=====
void OLED_ShowChar(uint8_t page, uint8_t col, char c)
{
    uint8_t i;
    const uint8_t *ptr = &ASCII[c - ' '][0];

    OLED_WriteCmd(0xB0 + page);       // 设置页地址
    OLED_WriteCmd(0x00 + (col & 0x0F)); // 列低4位
    OLED_WriteCmd(0x10 + (col >> 4));   // 列高4位

    for (i = 0; i < 5; i++)
    {
        OLED_WriteData(ptr[i]);
    }
    OLED_WriteData(0x00); // 间隔一列空白
}

// ===== 显示字符串 =====
void OLED_ShowString(uint8_t page, uint8_t col, const char *str)
{
    while (*str)
    {
        OLED_ShowChar(page, col, *str);
        col += 6;  // 每个字符占6列(5像素+1空白)
        str++;
    }
}

// ===== 开启显示（先清屏再开）=====
void OLED_DisplayOn(void)
{
    OLED_Clear();                // 先清屏
    OLED_WriteCmd(0xAF);         // 开显示
}

// ===== 关闭显示（先清屏再关）=====
void OLED_DisplayOff(void)
{
    OLED_Clear();                // 先清屏，再黑掉
    OLED_WriteCmd(0xAE);         // 关显示
}
